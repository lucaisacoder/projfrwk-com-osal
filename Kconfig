## Kconfig
```kconfig
menu "COM OSAL Configuration"
    config COM_OSAL_DEFINITION
        bool "Enable COM OSAL Definition"
        default n
        help
            Enable COM OSAL Definition
endmenu
```
